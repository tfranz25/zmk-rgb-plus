## Kconfig
```kconfig
menu "ZMK RGB Plus Custom Lighting"

config ZMK_RGB_PLUS
    bool "Enable ZMK RGB Plus advanced lighting effects"
    default n
    select LED_STRIP
    select SPI
    help
      Enable custom reactive typing, heatmap, ripple, fireplace, aurora,
      and other highly advanced directional lighting effects.

if ZMK_RGB_PLUS

config ZMK_RGB_PLUS_SETTINGS
    bool "Persist RGB Plus state across reboots"
    default y
    select SETTINGS
    help
      Saves the active effect, speed, brightness, and reactive toggle state
      to NVS flash. State is automatically restored on every boot.
      Uses a 3-second debounce before writing to protect flash endurance.

config ZMK_RGB_PLUS_BATTERY_SAVER
    bool "Enable battery saver mode"
    default y
    help
      Automatically drops the animation frame rate or turns off animations
      entirely when the keyboard is operating on battery power to save charge.

config ZMK_RGB_PLUS_AUTO_OFF_IDLE
    bool "Auto-off on idle"
    default y
    help
      Automatically turn off the RGB lights and suspend rendering when
      the keyboard enters an idle state.

config ZMK_RGB_PLUS_FPS_USB
    int "Frame rate on USB power (FPS)"
    default 60
    range 0 60
    help
      The rendering frame rate when connected to USB power. Higher values
      provide smoother animations (e.g., 40-60 FPS).

config ZMK_RGB_PLUS_FPS_BATTERY
    int "Frame rate on Battery power (FPS)"
    default 30
    range 0 60
    help
      The rendering frame rate when running on battery. Set to 0 to disable
      animations entirely and save maximum power when wireless.

config ZMK_RGB_PLUS_RIPPLE_SPEED
    int "Ripple propagation speed (hundredths of grid units/sec)"
    default 500
    help
      Controls how fast the splash ripple expands across the keyboard.
      A grid unit matches key sizes (e.g. 100 = 1 key width).

config ZMK_RGB_PLUS_RIPPLE_LIFETIME
    int "Ripple lifetime (milliseconds)"
    default 800
    help
      The duration in milliseconds that a keypress ripple remains active.
      Note: if CONFIG_ZMK_RGB_PLUS_RIPPLE_MAX_RADIUS is set, it will limit the ripple expansion distance.

config ZMK_RGB_PLUS_RIPPLE_MAX_RADIUS
    int "Ripple maximum radius (hundredths of grid units)"
    default 300
    help
      The maximum distance (radius) in hundredths of grid units that a keypress
      ripple can expand before fully fading out (e.g. 300 = 3 keys).

config ZMK_RGB_PLUS_HEATMAP_COOLING
    int "Heatmap cooling rate (percent per second)"
    default 90
    range 1 200
    help
      How quickly typed keys cool down back to the background color.
      Higher values mean faster cooling.

config ZMK_RGB_PLUS_RAINBOW_ANGLE
    int "Rainbow wave travel angle (degrees)"
    default 45
    range 0 360
    help
      The angle in degrees (0-360) at which the directional rainbow wave travels
      across the keyboard.

config ZMK_RGB_PLUS_DEFAULT_BRIGHTNESS
    int "Default brightness scaling percentage"
    default 80
    range 5 100
    help
      Sets the default maximum brightness scaling (out of 100) for custom animations.

endif # ZMK_RGB_PLUS

endmenu
```

## dts/bindings/zmk,behavior-rgb-plus.yaml
```yaml
# dts/bindings/zmk,behavior-rgb-plus.yaml
description: ZMK RGB Plus custom behavior to control animations and effects from your keymap.

compatible: "zmk,behavior-rgb-plus"

include: one_param.yaml

properties:
  "#binding-cells":
    const: 1
    description: |
      The command parameter:
      0: Next Effect
      1: Previous Effect
      2: Toggle Reactive overlay (e.g. layers)
      3: Increase Speed
      4: Decrease Speed
```

## dts/bindings/zmk,rgb-plus-layout.yaml
```yaml
# dts/bindings/zmk,rgb-plus-layout.yaml
description: Custom LED coordinate schema for layout-agnostic spatial RGB animations.

compatible: "zmk,rgb-plus-layout"

properties:
  led-coordinates:
    type: array
    required: true
    description: |
      An array of (X, Y) coordinate pairs mapping each underglow LED
      index to physical grid coordinates (e.g. <x y> in hundredths of U).
```

## zephyr/Kconfig
```kconfig
menu "ZMK RGB Plus Custom Lighting"

config ZMK_RGB_PLUS
    bool "Enable ZMK RGB Plus advanced lighting effects"
    default n
    depends on ZMK_RGB_UNDERGLOW
    help
      Enable custom reactive typing, heatmap, ripple, fireplace, aurora,
      and other highly advanced directional lighting effects.

if ZMK_RGB_PLUS

config ZMK_RGB_PLUS_BATTERY_SAVER
    bool "Enable battery saver mode"
    default y
    help
      Automatically drops the animation frame rate or turns off animations
      entirely when the keyboard is operating on battery power to save charge.

config ZMK_RGB_PLUS_FPS_USB
    int "Frame rate on USB power (FPS)"
    default 60
    range 0 60
    help
      The rendering frame rate when connected to USB power. Higher values
      provide smoother animations (e.g., 40-60 FPS).

config ZMK_RGB_PLUS_FPS_BATTERY
    int "Frame rate on Battery power (FPS)"
    default 30
    range 0 60
    help
      The rendering frame rate when running on battery. Set to 0 to disable
      animations entirely and save maximum power when wireless.

config ZMK_RGB_PLUS_RIPPLE_SPEED
    int "Ripple propagation speed (hundredths of grid units/sec)"
    default 500
    help
      Controls how fast the splash ripple expands across the keyboard.
      A grid unit matches key sizes (e.g. 100 = 1 key width).

config ZMK_RGB_PLUS_RIPPLE_LIFETIME
    int "Ripple lifetime (milliseconds)"
    default 800
    help
      The duration in milliseconds that a keypress ripple remains active.
      Note: if CONFIG_ZMK_RGB_PLUS_RIPPLE_MAX_RADIUS is set, it will limit the ripple expansion distance.

config ZMK_RGB_PLUS_RIPPLE_MAX_RADIUS
    int "Ripple maximum radius (hundredths of grid units)"
    default 300
    help
      The maximum distance (radius) in hundredths of grid units that a keypress
      ripple can expand before fully fading out (e.g. 300 = 3 keys).

config ZMK_RGB_PLUS_HEATMAP_COOLING
    int "Heatmap cooling rate (percent per second)"
    default 90
    range 1 100
    help
      How quickly typed keys cool down back to the background color.
      Higher values mean faster cooling.

config ZMK_RGB_PLUS_HEATMAP_OFF_BASE
    bool "Heatmap starts off (black) instead of dim blue/purple"
    default y
    help
      When enabled, keys with no heat will be completely off. As heat
      increases, they will light up and transition towards red.

config ZMK_RGB_PLUS_RAINBOW_ANGLE
    int "Rainbow wave travel angle (degrees)"
    default 45
    range 0 360
    help
      The angle in degrees (0-360) at which the directional rainbow wave travels
      across the keyboard.

config ZMK_RGB_PLUS_DEFAULT_BRIGHTNESS
    int "Default brightness scaling percentage"
    default 80
    range 5 100
    help
      Sets the default maximum brightness scaling (out of 100) for custom animations.

endif # ZMK_RGB_PLUS

endmenu
```
